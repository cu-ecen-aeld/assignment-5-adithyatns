## base_external/aesd_qemu_defconfig
```kconfig
BR2_DL_DIR="$HOME/buidlroot_dl"
BR2_CCACHE=y
BR2_TARGET_GENERIC_ROOT_PASSWD="root"
BR2_PACKAGE_DROPBEAR=y
BR2_PACKAGE_OPENSSH=y
BR2_TARGET_ROOTFS_EXT2=y
BR2_TARGET_ROOTFS_EXT2_4=y
BR2_PACKAGE_HOST_KMOD=y
BR2_PACKAGE_AESD_ASSIGNMENTS=y
```
